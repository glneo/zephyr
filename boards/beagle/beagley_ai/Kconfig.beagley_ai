## boards/beagle/beagley_ai/Kconfig.beagley_ai
```kconfig
# Copyright (c) 2024 Texas Instruments Incorporated
#	Andrew Davis <afd@ti.com>
#
# SPDX-License-Identifier: Apache-2.0

config BOARD_BEAGLEY_AI
	select SOC_J722S_R5 if BOARD_BEAGLEY_AI_J722S_MAIN_R5
	select SOC_J722S_R5 if BOARD_BEAGLEY_AI_J722S_MCU_R5
```

## boards/beagle/beagley_ai/beagley_ai_j722s_main_r5_defconfig
```kconfig
# Copyright (c) 2024 Texas Instruments Incorporated
#	Andrew Davis <afd@ti.com>
#
# SPDX-License-Identifier: Apache-2.0

# Zephyr Kernel Configuration
CONFIG_XIP=n

# Enable Pinctrl
CONFIG_PINCTRL=y

# Serial Driver
CONFIG_SERIAL=y
CONFIG_UART_INTERRUPT_DRIVEN=y

# Enable Console
CONFIG_CONSOLE=y
CONFIG_UART_CONSOLE=y

# Enable Mailbox
CONFIG_MBOX=y
```

## drivers/i2c/Kconfig.omap
```kconfig
config I2C_OMAP
	bool "TI OMAP I2C Driver"
	default y
	help
		Enable the I2C driver for TI OMAP SoCs.
```

## drivers/mbox/Kconfig.ti_omap
```kconfig
# Copyright 2022 NXP
# SPDX-License-Identifier: Apache-2.0

config MBOX_TI_OMAP_MAILBOX
	bool "TI OMAP Mailbox driver"
	default y
	help
	  Driver for TI OMAP Mailbox.
```

## samples/hello_world/boards/beaglebone_ai64_j721e_main_r5f0_0.conf
```kconfig
CONFIG_LOG=y
CONFIG_LOG_OUTPUT=y
CONFIG_LOG_BACKEND_UART=y

CONFIG_SHELL=y
CONFIG_SHELL_BACKENDS=y
CONFIG_SHELL_BACKEND_SERIAL=y
CONFIG_I2C=y
CONFIG_I2C_SHELL=y
```
