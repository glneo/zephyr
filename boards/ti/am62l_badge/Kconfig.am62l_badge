## boards/ti/am62l_badge/Kconfig.am62l_badge
```kconfig
# Texas Instruments Sitara AM62L Badge
#
# Copyright (c) 2025 Texas Instruments Incorporated
#
# SPDX-License-Identifier: Apache-2.0

config BOARD_AM62L_BADGE
	select SOC_AM62L3_A53
```

## boards/ti/am62l_badge/board.yml
```yaml
board:
  name: am62l_badge
  full_name: AM62L Badge
  vendor: ti
  socs:
  - name: am62l3
```

## boards/ti/sk_am62a/sk_am62a_am62a7_mcu_r5f0_0_defconfig
```kconfig
# Copyright (c) 2025 Texas Instruments Incorporated
#	Andrew Davis <afd@ti.com>
#
# SPDX-License-Identifier: Apache-2.0

# Zephyr Kernel Configuration
CONFIG_XIP=n
```

## dts/bindings/display/solomon,ssd1683.yaml
```yaml
# Copyright (C) 2020-2024 Texas Instruments Incorporated - https://www.ti.com/
# SPDX-License-Identifier: Apache-2.0

description: Solomon Systech SSD1683 400x300 EPD display controller

compatible: "solomon,ssd1683"

include: solomon,ssd16xx-common.yaml
```

## samples/drivers/display/boards/am62l_evm_am62l3_a53.conf
```kconfig
# Copyright (C) 2025 Texas Instruments Incorporated - https://www.ti.com/
# SPDX-License-Identifier: Apache-2.0

# Need more memory for larger display (400x300)
CONFIG_HEAP_MEM_POOL_SIZE=65536

# GPIO Driver
CONFIG_GPIO=y

#CONFIG_LOG=y
CONFIG_LOG_BACKEND_UART=y

CONFIG_LOG_DEFAULT_LEVEL=3
#CONFIG_DISPLAY_LOG_LEVEL_DBG=y
```
